## CMakeLists.txt
```
 # Minimum version of CMake required to build this project
cmake_minimum_required(VERSION 3.20.0)
 
# Load the Zephyr build system
# ZEPHYR_BASE is an environment variable set during SDK installation
find_package(Zephyr REQUIRED HINTS $ENV{ZEPHYR_BASE})
 
# Give your project a name
project(ble_tracker)
 
# Tell CMake which source files to include in the build
# Add a new line here every time you create a new .c file
target_sources(app PRIVATE
    src/main.c
    src/tracker_service.c
)
```

## prj.conf
```kconfig
CONFIG_LOG=y
CONFIG_BT=y
CONFIG_BT_PERIPHERAL=y
CONFIG_BT_DEVICE_NAME="RishiTracker"
CONFIG_MAIN_STACK_SIZE=2048
CONFIG_BT_RX_STACK_SIZE=2048
```

## src/main.c
```c
#include <zephyr/kernel.h>
#include <zephyr/bluetooth/bluetooth.h>
#include <zephyr/bluetooth/conn.h>
#include <zephyr/logging/log.h>
#include "tracker_service.h"

LOG_MODULE_REGISTER(main, LOG_LEVEL_DBG);


// ADVERTISING DATA
static const struct bt_data advertising_data[] = {
    BT_DATA_BYTES(BT_DATA_FLAGS, BT_LE_AD_GENERAL | BT_LE_AD_NO_BREDR), BT_DATA_BYTES(BT_DATA_NAME_COMPLETE,'R','i','s','h','i','T', 'r', 'a', 'c', 'k', 'e', 'r'),
};

static void start_advertising(void);

 // errif 0= connected successfully
static void on_connected(struct bt_conn *conn, uint8_t err)
{
    if (err != 0)
    {
        LOG_ERR("Connection attempt failed. Error code: %d", err);
        start_advertising();
        return;
    }
    LOG_INF("A device just connected!");
}

//   0x08 → Connection timed out (signal lost)
 //   0x13 → Remote device disconnected (phone closed app)
 //   0x16 → We disconnected ourselves (local host terminated)
static void on_disconnected(struct bt_conn *conn, uint8_t reason)
{
    LOG_INF("Device disconnected. Reason code: 0x%02X", reason);
    LOG_INF("Re-starting advertising so we can be found again...");
    start_advertising();
}

// This tells Zephyr which functions to call for connection events.
BT_CONN_CB_DEFINE(connection_callbacks) = {
    .connected    = on_connected,
    .disconnected = on_disconnected,
};


static void start_advertising(void)
{
    int result;
     //the function that actually starts the radio
    result = bt_le_adv_start(BT_LE_ADV_NCONN, advertising_data, ARRAY_SIZE(advertising_data), NULL, 0);

    // Check if advertising failed to start
    if (result != 0)
    {
        LOG_ERR("Failed to start advertising! Error code: %d", result);
        return;
    }

    LOG_INF("Advertising started!");
}

static void on_bluetooth_ready(int err)
{
    if (err != 0)
    {
        LOG_ERR("Bluetooth failed to initialize! Error: %d", err);
        return;
    }

    LOG_INF("Bluetooth hardware is ready!");
    tracker_service_init();
    start_advertising();
}

int main(void)
{
    int result;
    LOG_INF("  TrackerDK BLE Peripheral Starting...  ");
    result = bt_enable(on_bluetooth_ready);
    if (result != 0)
    {
        LOG_ERR("bt_enable() failed! BLE cannot start. Error: %d", result);
        return result;
    }
    LOG_INF("BLE initialization started, waiting for hardware...");
    while (1)
    {
        k_sleep(K_FOREVER);
    }
    return 0;
}
```

## src/tracker_service.c
```c
#include <zephyr/bluetooth/bluetooth.h>
#include <zephyr/bluetooth/gatt.h>
#include <zephyr/logging/log.h>
#include "tracker_service.h"

LOG_MODULE_REGISTER(tracker_service, LOG_LEVEL_DBG);

#define MY_SERVICE_UUID BT_UUID_DECLARE_128(BT_UUID_128_ENCODE(0x12345678, 0x1234, 0x5678, 0x1234, 0x56789abcdef0))
#define MY_CHAR_UUID    BT_UUID_DECLARE_128(BT_UUID_128_ENCODE(0x12345678, 0x1234, 0x5678, 0x1234, 0x56789abcdef1))

static uint8_t sensor_value = 0x42;

static ssize_t on_characteristic_read(struct bt_conn *conn, const struct bt_gatt_attr *attr, void *buf, uint16_t len, uint16_t offset)
{
    LOG_INF("Read! Sending value: 0x%02X (%d)", sensor_value, sensor_value);
    return bt_gatt_attr_read(conn, attr, buf, len, offset, &sensor_value, sizeof(sensor_value));
}


BT_GATT_SERVICE_DEFINE(tracker_gatt_service,
    BT_GATT_PRIMARY_SERVICE(MY_SERVICE_UUID),
    BT_GATT_CHARACTERISTIC(MY_CHAR_UUID, BT_GATT_CHRC_READ, BT_GATT_PERM_READ, on_characteristic_read, NULL, NULL),
);

int tracker_service_init(void)
{
    LOG_INF("GATT service ready. Characteristic value = 0x%02X", sensor_value);
    return 0;
}

int tracker_service_set_value(uint8_t new_value)
{
    sensor_value = new_value;
    LOG_INF("Value updated to 0x%02X (%d decimal)", new_value, new_value);
    return 0;
}
```

## src/tracker_service.h
```c
#ifndef TRACKER_SERVICE_H
#define TRACKER_SERVICE_H
#include <stdint.h>
int tracker_service_init(void);
int tracker_service_set_value(uint8_t new_value);
#endif 
```
