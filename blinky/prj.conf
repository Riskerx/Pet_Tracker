## prj.conf
```kconfig
#CONFIG_GPIO=y
CONFIG_BOOT_BANNER=n
CONFIG_LOG=y
CONFIG_LOG_PRINTK=y
```

## nrf52840dk_nrf52840.overlay
```dts
/*
 * Overlay for nrf52840dk_nrf52840
 *
 * Demonstrates two types of devicetree overrides:
 *   1. Alias redirect  — changes WHICH node led0 resolves to
 *   2. Property override — changes a property ON a specific node
 */

/ {
	aliases {
		led0 = &led1;
	};
};


&led0 {
	gpios = <&gpio0 13 GPIO_ACTIVE_HIGH>;
	label = "Green LED 0 (polarity flipped)";
};
```

## src/main.c
```c
/*
 * Copyright (c) 2016 Intel Corporation
 *
 * SPDX-License-Identifier: Apache-2.0
 */

#include <stdio.h>
#include <zephyr/kernel.h>
/* GPIO drivers must be enabled by CONFIG_GPIO to be included in the build */
#include <zephyr/drivers/gpio.h>
#include <zephyr/logging/log.h>
/* Devicetree helper macros (DT_ALIAS, etc.) */
#include <zephyr/devicetree.h>

LOG_MODULE_REGISTER(blinky, LOG_LEVEL_DBG); //registers this file as log module "blinky"

/* 1000 msec = 1 sec */
#define SLEEP_TIME_MS   1000

/* The devicetree node identifier for the "led0" alias. */
#define LED0_NODE DT_ALIAS(led0)

/*
 * A build error on this line means your board is unsupported.
 * See the sample documentation for information on how to fix this.
 */
static const struct gpio_dt_spec led = GPIO_DT_SPEC_GET(LED0_NODE, gpios);

int main(void)
{
	int ret;
	bool led_state = true;

	if (!gpio_is_ready_dt(&led)) {
		return 0;
	}

	ret = gpio_pin_configure_dt(&led, GPIO_OUTPUT_ACTIVE);
	if (ret < 0) {
		return 0;
	}

	while (1) {
		ret = gpio_pin_toggle_dt(&led);
		if (ret < 0) {
			return 0;
		}

		led_state = !led_state;
		printf("LED state: %s", led_state ? "ON" : "OFF");
		k_msleep(SLEEP_TIME_MS);
	}
	return 0;
}
```
