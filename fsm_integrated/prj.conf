## CMakeLists.txt
```
cmake_minimum_required(VERSION 3.20.0)
find_package(Zephyr REQUIRED HINTS $ENV{ZEPHYR_BASE})
project(fsm_integrated)

target_sources(app PRIVATE
    src/main.c
    src/app/state_machine.c
    src/sensor/sensor_mock.c
    src/storage/storage_nvs.c
    src/ble/ble_service.c
    src/ble/ble_notify.c
)
target_include_directories(app PRIVATE src)
```

## prj.conf
```kconfig
CONFIG_LOG=y
CONFIG_LOG_DEFAULT_LEVEL=3
CONFIG_LOG_MODE_IMMEDIATE=y
CONFIG_SYSTEM_WORKQUEUE_STACK_SIZE=4096
CONFIG_BT=y
CONFIG_BT_PERIPHERAL=y
CONFIG_BT_DEVICE_NAME="PetTracker"
CONFIG_BT_MAX_CONN=1
CONFIG_BT_SMP=n
CONFIG_FLASH=y
CONFIG_FLASH_MAP=y
CONFIG_NVS=y
CONFIG_MPU_ALLOW_FLASH_WRITE=y
CONFIG_GPIO=y
```

## nrf52840dk_nrf52840.overlay
```dts
&flash0 {
	partitions {
		my_storage_partition: partition@7a000 {
			label = "my_storage";
			reg = <0x7a000 0x6000>;
		};
	};
};
```

## src/main.c
```c
#include <zephyr/kernel.h>
#include <zephyr/logging/log.h>
#include "storage/storage.h"
#include "ble/ble.h"
#include "app/state_machine.h"

LOG_MODULE_REGISTER(main, LOG_LEVEL_DBG);

int main(void)
{
        LOG_INF("Pet Tracker booting.....");

        int rc = storage_init();
        if (rc)
        {
                LOG_WRN("Storage init failed (%d) — continuing without flash", rc);
        }

        rc = ble_init();
        if (rc)
        {
                LOG_ERR("BLE init failed: %d", rc);
                return rc;
        }

        rc = state_machine_start();
        if (rc)
        {
                LOG_ERR("FSM start failed: %d", rc);
                return rc;
        }

        LOG_INF("Boot complete — press SW0 to trigger motion");

        k_sleep(K_FOREVER);
        return 0;
}
```
