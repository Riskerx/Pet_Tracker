## CMakeLists.txt
```
cmake_minimum_required(VERSION 3.20.0)
find_package(Zephyr REQUIRED HINTS $ENV{ZEPHYR_BASE})
project(periph_drivers_test)

add_subdirectory(${CMAKE_CURRENT_SOURCE_DIR}/../../lib/periph_drivers periph_drivers_build)

target_sources(app PRIVATE
  src/test_haptic.c
  src/test_mag.c
)
```

## prj.conf
```kconfig
CONFIG_ZTEST=y

CONFIG_PERIPH_HAPTIC_DRV2605=n
CONFIG_PERIPH_MAG_BMM350=n
```

## src/test_haptic.c
```c
#include <zephyr/ztest.h>
#include <errno.h>
#include <periph/haptic_iface.h>
#include <periph/haptic_mock.h>

static struct haptic_dev *hap;

static void *haptic_suite_setup(void)
{
    hap = haptic_mock_get();
    return NULL;
}

static void haptic_before(void *fixture)
{
    (void)fixture;
    zassert_ok(haptic_init(hap), "mock init should always succeed");
}

ZTEST_SUITE(haptic_mock, NULL, haptic_suite_setup, haptic_before, NULL, NULL);

ZTEST(haptic_mock, test_init_sets_known_register_state)
{
    const struct drv2605_mock_regs *regs = haptic_mock_peek_regs();

    zassert_equal(regs->go, 0, "GO bit must be clear after init");
    zassert_equal(regs->waveseq[0], 0, "sequencer must be empty after init");
}

ZTEST(haptic_mock, test_play_effect_sets_go_bit)
{
    zassert_ok(haptic_play_effect(hap, 47));

    const struct drv2605_mock_regs *regs = haptic_mock_peek_regs();

    zassert_equal(regs->waveseq[0], 47, "effect id should land in slot 0");
    zassert_equal(regs->waveseq[1], 0, "slot 1 should terminate the sequence");
    zassert_equal(regs->go, 1, "GO bit should be set to start playback");
    zassert_true(haptic_is_playing(hap));
}

ZTEST(haptic_mock, test_stop_clears_go_bit)
{
    zassert_ok(haptic_play_effect(hap, 1));
    zassert_true(haptic_is_playing(hap));

    zassert_ok(haptic_stop(hap));

    zassert_false(haptic_is_playing(hap));
    zassert_equal(haptic_mock_peek_regs()->go, 0);
}

ZTEST(haptic_mock, test_effect_id_zero_is_rejected)
{

    zassert_equal(haptic_play_effect(hap, 0), -EINVAL);
}

ZTEST(haptic_mock, test_effect_id_above_max_is_rejected)
{
    zassert_equal(haptic_play_effect(hap, HAPTIC_EFFECT_MAX + 1), -EINVAL);
}

ZTEST(haptic_mock, test_effect_id_boundaries_are_accepted)
{
    zassert_ok(haptic_play_effect(hap, HAPTIC_EFFECT_MIN));
    zassert_ok(haptic_play_effect(hap, HAPTIC_EFFECT_MAX));
}
```

## src/test_mag.c
```c
#include <zephyr/ztest.h>
#include <errno.h>
#include <periph/mag_iface.h>
#include <periph/mag_mock.h>

static struct mag_dev *mag;

static void *mag_suite_setup(void)
{
    mag = mag_mock_get();
    return NULL;
}

static void mag_before(void *fixture)
{
    (void)fixture;
    zassert_ok(mag_init(mag), "mock init should succeed with a valid chip id");
}

ZTEST_SUITE(mag_mock, NULL, mag_suite_setup, mag_before, NULL, NULL);

ZTEST(mag_mock, test_init_reads_expected_chip_id)
{
    const struct bmm350_mock_regs *regs = mag_mock_peek_regs();

    zassert_equal(regs->chip_id, 0x33, "BMM350 CHIP_ID must read back 0x33");
    zassert_equal(regs->pmu_cmd, 0x01, "power mode should be NORMAL after init");
}

ZTEST(mag_mock, test_fetch_then_get_returns_a_sample)
{
    struct mag_sample sample;

    zassert_ok(mag_sample_fetch(mag));
    zassert_ok(mag_get_data(mag, &sample));

    zassert_equal(sample.z, 4000, "z axis is fixed in the synthetic model");
}

ZTEST(mag_mock, test_repeated_fetches_are_deterministic)
{
    struct mag_sample first, second;

    zassert_ok(mag_sample_fetch(mag));
    zassert_ok(mag_get_data(mag, &first));

    zassert_ok(mag_init(mag));
    zassert_ok(mag_sample_fetch(mag));
    zassert_ok(mag_get_data(mag, &second));

    zassert_equal(first.x, second.x, "same fetch index must give the same sample");
    zassert_equal(first.y, second.y, "same fetch index must give the same sample");
}

ZTEST(mag_mock, test_get_data_rejects_null_output)
{
    zassert_equal(mag_get_data(mag, NULL), -EINVAL);
}
```
