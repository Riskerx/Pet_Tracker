## CMakeLists.txt
```
cmake_minimum_required(VERSION 3.20.0)

find_package(Zephyr REQUIRED HINTS $ENV{ZEPHYR_BASE})
project(pet_tracker_rc)

target_sources(app PRIVATE
    src/main.c
    src/app_state.c
    src/state_machine/state_machine.c
    src/ble/ble_adv.c
    src/ble/tracker_service.c
    src/ble/data_transfer.c
    src/sensor/motion_sensor.c
    src/storage/flash_log.c
    src/power/power_mgmt.c
    src/ota/ota_stub.c
    src/drivers/haptic_stub.c
)

target_include_directories(app PRIVATE src)
```

## prj.conf
```kconfig
# --- Core ---
CONFIG_GPIO=y

# --- Bluetooth ---
CONFIG_BT=y
CONFIG_BT_PERIPHERAL=y
CONFIG_BT_DEVICE_NAME="RishiTracker"
CONFIG_BT_DEVICE_APPEARANCE=833

# Nordic UART Service, used by ble/data_transfer.c for chunked log dumps
CONFIG_BT_NUS=y

# --- Security / bonding ---
# Enables pairing + bond storage. The passkey-display bonding flow
# itself (verified working via nRF Connect per earlier project work)
# isn't among the five source files this RC consolidates from, so
# only the Kconfig side is wired in here - see README "Known
# Limitations".
CONFIG_BT_SMP=y
CONFIG_BT_BONDABLE=y
CONFIG_BT_SETTINGS=y
CONFIG_SETTINGS=y
CONFIG_FLASH=y
CONFIG_FLASH_MAP=y
CONFIG_FLASH_PAGE_LAYOUT=y
CONFIG_NVS=y

# --- Sensor (BMI270) ---
# Only exercised when app_config.h has TRACKER_SIM_MOTION set to 0.
CONFIG_SENSOR=y
CONFIG_BMI270=y

# --- Logging ---
CONFIG_LOG=y
CONFIG_LOG_MODE_DEFERRED=y
```

## src/main.c
```c
#include <zephyr/kernel.h>
#include <zephyr/logging/log.h>

#include "app_state.h"
#include "state_machine/state_machine.h"
#include "ble/ble_adv.h"
#include "sensor/motion_sensor.h"
#include "storage/flash_log.h"
#include "power/power_mgmt.h"
#include "ota/ota_stub.h"
#include "drivers/haptic_stub.h"

LOG_MODULE_REGISTER(app_main, LOG_LEVEL_INF);

/*
 * Single init chain, replacing five separate main()s from the
 * standalone modules. Order matters:
 *   1. app_state / storage / power / ota / haptic - no dependencies
 *      on Bluetooth, safe to bring up first.
 *   2. ble_adv - owns bt_enable(); tracker_service + data_transfer
 *      are initialized from inside its ready callback so GATT/NUS
 *      registration always happens after the BT stack is up.
 *   3. motion_sensor - starts producing motion events (real IRQ or
 *      simulated timer), which the state machine below is now ready
 *      to receive.
 *   4. state_machine - initialized last so nothing can fire a
 *      transition before its work items exist.
 */
int main(void)
{
    LOG_INF("=== Pet Tracker RC booting ===");

    app_state_init();
    storage_init();
    power_mgmt_init();
    ota_init();
    haptic_init();

    ble_adv_init();

    int err = motion_sensor_init();
    if (err) {
        LOG_ERR("motion_sensor_init failed: %d (continuing - BLE/state machine still run)", err);
    }

    state_machine_init();

    LOG_INF("Setup complete - RC pipeline running");

    k_sleep(K_FOREVER);
    return 0;
}
```
