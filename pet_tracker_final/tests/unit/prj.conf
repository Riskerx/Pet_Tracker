## CMakeLists.txt
```
cmake_minimum_required(VERSION 3.20.0)

find_package(Zephyr REQUIRED HINTS $ENV{ZEPHYR_BASE})
project(pet_tracker_unit_tests)

# Points back at the real source tree being tested - nothing here is
# copied, every file below is the actual production file (or, for
# fakes.c, the file that replaces one specific real file).
set(PT_SRC ${CMAKE_CURRENT_SOURCE_DIR}/../../src)

target_include_directories(app PRIVATE ${PT_SRC})

target_sources(app PRIVATE
    # --- Real production code under test ---
    ${PT_SRC}/app_state.c
    ${PT_SRC}/state_machine/state_machine.c
    ${PT_SRC}/storage/flash_log.c
    ${PT_SRC}/power/power_mgmt.c
    ${PT_SRC}/ota/ota_stub.c
    ${PT_SRC}/drivers/haptic_stub.c

    # --- Test doubles ---
    # Replaces ble/tracker_service.c (needs a real BLE stack) and the
    # motion_sensor_get_last_sample() half of sensor/motion_sensor.c
    # (needs real/simulated hardware timing) with deterministic fakes.
    src/fakes.c

    # --- Test suites ---
    src/test_state_machine.c
    src/test_flash_log.c
    src/test_power_ota.c
    src/test_ota_stub.c
    src/test_haptic_stub.c
)
```

## prj.conf
```kconfig
# Deliberately minimal: because ble/tracker_service.c and the hardware
# half of sensor/motion_sensor.c are replaced with fakes.c, this test
# needs no CONFIG_BT_*, CONFIG_SENSOR, or CONFIG_BMI270 - it's testing
# application logic, not radios or drivers.

CONFIG_ZTEST=y
CONFIG_ZTEST_ASSERT_VERBOSE=1

# If your exact Zephyr version still gates the ZTEST()/ZTEST_SUITE()
# macros behind the "new" ztest API, uncomment the line below:
# CONFIG_ZTEST_NEW_API=y
```

## src/fakes.c
```c
#include "fakes.h"

int fake_notify_status_calls;
tracker_status_t fake_last_status;

int fake_notify_motion_calls;
struct motion_sample fake_last_motion;

static struct motion_sample injected_sample;

/* ---- fakes for ble/tracker_service.h ---- */

void tracker_service_notify_status(tracker_status_t status)
{
    fake_notify_status_calls++;
    fake_last_status = status;
}

void tracker_service_notify_motion(const struct motion_sample *sample)
{
    fake_notify_motion_calls++;
    fake_last_motion = *sample;
}

/* ---- fake for sensor/motion_sensor.h ---- */

struct motion_sample motion_sensor_get_last_sample(void)
{
    return injected_sample;
}

void fake_motion_sensor_set_sample(struct motion_sample sample)
{
    injected_sample = sample;
}

void fakes_reset(void)
{
    fake_notify_status_calls = 0;
    fake_notify_motion_calls = 0;
    fake_last_status = 0;

    struct motion_sample zero = { 0 };
    fake_last_motion = zero;
    injected_sample = zero;
}
```

## src/fakes.h
```c
#ifndef FAKES_H_
#define FAKES_H_

#include "ble/tracker_service.h"
#include "sensor/motion_sensor.h"

/*
 * Test doubles for the two things a host-based (native_sim) test
 * genuinely can't exercise for real: the BLE radio (tracker_service's
 * notify functions) and a physical/simulated sensor (motion_sensor's
 * sample source). Everything else under test - state machine,
 * storage, power flags, OTA stub - is the REAL production code.
 */

extern int fake_notify_status_calls;
extern tracker_status_t fake_last_status;

extern int fake_notify_motion_calls;
extern struct motion_sample fake_last_motion;

/* Sets what the next motion_sensor_get_last_sample() call returns. */
void fake_motion_sensor_set_sample(struct motion_sample sample);

/* Resets every counter/value above. Call from a ztest "before" hook. */
void fakes_reset(void);

#endif /* FAKES_H_ */
```

## src/test_flash_log.c
```c
#include <zephyr/ztest.h>
#include <zephyr/kernel.h>

#include "storage/flash_log.h"
#include "app_state.h"

#define RECORD(t, xx, yy, zz) \
    (struct tracker_log_record){ .timestamp_ms = (t), .sample = { .x = (xx), .y = (yy), .z = (zz) } }

static void *suite_setup(void)
{
    app_state_init();
    return NULL;
}

static void case_before(void *fixture)
{
    ARG_UNUSED(fixture);
    storage_erase();
}

ZTEST_SUITE(flash_log_tests, NULL, suite_setup, case_before, NULL, NULL);

ZTEST(flash_log_tests, test_save_then_read_single_record)
{
    struct tracker_log_record rec = RECORD(1000, 1, 2, 3);
    zassert_equal(storage_save(&rec), 0, "storage_save should return 0");

    struct tracker_log_record out[1];
    size_t n = 0;
    zassert_equal(storage_read(out, 1, &n), 0, "storage_read should return 0");
    zassert_equal(n, 1, "should read back exactly the one saved record");
    zassert_equal(out[0].timestamp_ms, 1000, "timestamp should round-trip");
    zassert_equal(out[0].sample.x, 1, "sample.x should round-trip");
}

ZTEST(flash_log_tests, test_erase_clears_buffer)
{
    struct tracker_log_record rec = RECORD(1, 1, 1, 1);
    storage_save(&rec);
    storage_erase();

    struct tracker_log_record out[4];
    size_t n = 99;
    storage_read(out, 4, &n);
    zassert_equal(n, 0, "buffer should be empty after erase");
}

ZTEST(flash_log_tests, test_read_caps_at_requested_max)
{
    for (int i = 0; i < 5; i++) {
        struct tracker_log_record rec = RECORD(i, i, i, i);
        storage_save(&rec);
    }

    struct tracker_log_record out[2];
    size_t n = 0;
    storage_read(out, 2, &n);
    zassert_equal(n, 2, "read should cap at the caller's max_records, not the total saved");
}

ZTEST(flash_log_tests, test_ring_buffer_wraparound_keeps_newest)
{
    /* Save more than the 64-record capacity and confirm the oldest
     * ones were the ones overwritten, not the newest. */
    const int total = 70;

    for (int i = 0; i < total; i++) {
        struct tracker_log_record rec = RECORD(i, 0, 0, 0);
        storage_save(&rec);
    }

    struct tracker_log_record out[64];
    size_t n = 0;
    storage_read(out, 64, &n);

    zassert_equal(n, 64, "buffer should be full at capacity after wraparound");
    zassert_equal(out[0].timestamp_ms, total - 64, "oldest surviving record is wrong");
    zassert_equal(out[63].timestamp_ms, total - 1, "newest record is wrong");
}

/* ---- Concurrency: proves storage_lock actually prevents corruption
 * when two threads save at once - this is the "Flash + BLE" conflict
 * from architecture.md, exercised directly rather than just asserted
 * by inspection. ---- */

#define THREAD_STACK_SIZE   1024
#define RECORDS_PER_THREAD  20

K_THREAD_STACK_DEFINE(producer_a_stack, THREAD_STACK_SIZE);
K_THREAD_STACK_DEFINE(producer_b_stack, THREAD_STACK_SIZE);
static struct k_thread producer_a_tid;
static struct k_thread producer_b_tid;

static void producer_entry(void *p1, void *p2, void *p3)
{
    ARG_UNUSED(p2);
    ARG_UNUSED(p3);
    int32_t tag = (int32_t)(intptr_t)p1;

    for (int i = 0; i < RECORDS_PER_THREAD; i++) {
        struct tracker_log_record rec = RECORD(i, tag, i, 0);
        storage_save(&rec);
    }
}

ZTEST(flash_log_tests, test_concurrent_saves_do_not_corrupt_count)
{
    k_tid_t a = k_thread_create(&producer_a_tid, producer_a_stack, THREAD_STACK_SIZE,
                                 producer_entry, (void *)1, NULL, NULL,
                                 5, 0, K_NO_WAIT);
    k_tid_t b = k_thread_create(&producer_b_tid, producer_b_stack, THREAD_STACK_SIZE,
                                 producer_entry, (void *)2, NULL, NULL,
                                 5, 0, K_NO_WAIT);

    k_thread_join(a, K_FOREVER);
    k_thread_join(b, K_FOREVER);

    struct tracker_log_record out[64];
    size_t n = 0;
    storage_read(out, 64, &n);

    /* 40 saves total, capacity is 64, so nothing should wrap. If the
     * mutex ever let two saves interleave and corrupt head/count,
     * this would come out wrong (or storage_read would crash). */
    zassert_equal(n, RECORDS_PER_THREAD * 2, "no records should be lost or duplicated");
}
```

## src/test_haptic_stub.c
```c
#include <zephyr/ztest.h>

#include "drivers/haptic_stub.h"

ZTEST_SUITE(haptic_stub_tests, NULL, NULL, NULL, NULL, NULL);

ZTEST(haptic_stub_tests, test_init_and_buzz_do_not_crash)
{
    /* Smoke test only - the stub has no observable state to assert on. */
    haptic_init();
    haptic_buzz();
    zassert_true(true, "haptic stub calls should not crash");
}
```

## src/test_ota_stub.c
```c
#include <zephyr/ztest.h>
#include <zephyr/kernel.h>

#include "ota/ota_stub.h"
#include "power/power_mgmt.h"
#include "app_state.h"

static void *suite_setup(void)
{
    power_mgmt_init();
    ota_init();
    return NULL;
}

ZTEST_SUITE(ota_stub_tests, NULL, suite_setup, NULL, NULL, NULL);

ZTEST(ota_stub_tests, test_ota_start_completes_and_releases_the_lock)
{
    /*
     * ota_start() is currently synchronous - locks, logs, and
     * immediately unlocks, since there's no real image transfer
     * behind it yet. This proves the power_mgmt lock/unlock handshake
     * completes cleanly. It does NOT prove anything about a real
     * transfer or rollback being safe - there's no MCUboot/DFU
     * backend to test yet. See TEST_REPORT.md, "Known gaps".
     */
    ota_start();
    zassert_equal(atomic_get(&ota_active), 0,
                  "ota_active should be released once ota_start() returns");
}
```

## src/test_power_ota.c
```c
#include <zephyr/ztest.h>
#include <zephyr/kernel.h>

#include "power/power_mgmt.h"
#include "app_state.h"

static void *suite_setup(void)
{
    power_mgmt_init();
    return NULL;
}

ZTEST_SUITE(power_ota_flag_tests, NULL, suite_setup, NULL, NULL, NULL);

ZTEST(power_ota_flag_tests, test_ota_lock_sets_flag)
{
    power_ota_lock();
    zassert_equal(atomic_get(&ota_active), 1, "ota_active should be set after power_ota_lock()");
    power_ota_unlock();
}

ZTEST(power_ota_flag_tests, test_ota_unlock_clears_flag)
{
    power_ota_lock();
    power_ota_unlock();
    zassert_equal(atomic_get(&ota_active), 0, "ota_active should clear after power_ota_unlock()");
}

ZTEST(power_ota_flag_tests, test_notify_activity_does_not_crash_when_idle)
{
    /*
     * Deliberately weak assertion: power_notify_activity() only
     * resets a private k_timer with no externally observable state,
     * short of waiting out the real 10s inactivity timeout. This
     * proves it's safe to call at any time. The timer's actual
     * expiry behavior (and the OTA-blocks-sleep path specifically)
     * is covered by the bench procedure in TEST_REPORT.md instead,
     * where it can be observed directly rather than inferred.
     */
    power_notify_activity();
    zassert_true(true, "power_notify_activity should not crash or hang");
}
```

## src/test_state_machine.c
```c
#include <zephyr/ztest.h>
#include <zephyr/kernel.h>

#include "state_machine/state_machine.h"
#include "storage/flash_log.h"
#include "app_state.h"
#include "fakes.h"

/*
 * These exercise the REAL state_machine.c + REAL flash_log.c together
 * - this is the "state machine + storage" integration path. BLE
 * notify is faked (see fakes.c); everything else is production code.
 */

/* Time for the system workqueue to run the FSM's four chained
 * k_work items (motion -> logging -> ble_notify -> idle) after one
 * state_machine_on_motion_event(). Generous for work items that do
 * no real I/O. */
#define SETTLE_MS 50

static void wait_for_cycle(void)
{
    k_msleep(SETTLE_MS);
}

static void *suite_setup(void)
{
    app_state_init();
    storage_init();
    state_machine_init();
    return NULL;
}

static void case_before(void *fixture)
{
    ARG_UNUSED(fixture);
    fakes_reset();
    storage_erase();
    atomic_set(&ble_transfer_active, 0);
}

ZTEST_SUITE(state_machine_tests, NULL, suite_setup, case_before, NULL, NULL);

ZTEST(state_machine_tests, test_full_cycle_logs_and_notifies)
{
    struct motion_sample sample = { .x = 11, .y = -22, .z = 933 };
    fake_motion_sensor_set_sample(sample);

    state_machine_on_motion_event();
    wait_for_cycle();

    zassert_equal(fake_notify_status_calls, 1, "status should notify exactly once");
    zassert_equal(fake_notify_motion_calls, 1, "motion should notify exactly once");
    zassert_equal(fake_last_status, TRACKER_STATUS_MOVING, "status payload should be MOVING");
    zassert_equal(fake_last_motion.x, sample.x, "notified sample.x should match the sensor");
    zassert_equal(fake_last_motion.y, sample.y, "notified sample.y should match the sensor");
    zassert_equal(fake_last_motion.z, sample.z, "notified sample.z should match the sensor");

    struct tracker_log_record recs[4];
    size_t n = 0;
    storage_read(recs, 4, &n);
    zassert_equal(n, 1, "exactly one record should have been logged");
    zassert_equal(recs[0].sample.x, sample.x, "logged record should match the sensor sample");
}

ZTEST(state_machine_tests, test_repeated_motion_events_each_log_and_notify)
{
    struct motion_sample sample = { .x = 1, .y = 2, .z = 3 };
    fake_motion_sensor_set_sample(sample);

    for (int i = 0; i < 3; i++) {
        state_machine_on_motion_event();
        wait_for_cycle();
    }

    zassert_equal(fake_notify_status_calls, 3, "three motion events should notify status three times");
    zassert_equal(fake_notify_motion_calls, 3, "three motion events should notify motion three times");

    struct tracker_log_record recs[8];
    size_t n = 0;
    storage_read(recs, 8, &n);
    zassert_equal(n, 3, "three motion events should log three records");
}

ZTEST(state_machine_tests, test_notify_skipped_while_ble_transfer_active)
{
    /* Directly exercises the "Notification + Data Transfer" conflict
     * resolution documented in architecture.md. */
    struct motion_sample sample = { .x = 5, .y = 5, .z = 5 };
    fake_motion_sensor_set_sample(sample);

    atomic_set(&ble_transfer_active, 1);

    state_machine_on_motion_event();
    wait_for_cycle();

    zassert_equal(fake_notify_status_calls, 0, "notify should be skipped during a transfer");
    zassert_equal(fake_notify_motion_calls, 0, "notify should be skipped during a transfer");

    struct tracker_log_record recs[4];
    size_t n = 0;
    storage_read(recs, 4, &n);
    zassert_equal(n, 1, "the motion event should still be logged even though notify was skipped");

    atomic_set(&ble_transfer_active, 0);

    /* Proves the skip isn't a stuck/latched flag - the next event
     * after the transfer ends should notify normally. */
    state_machine_on_motion_event();
    wait_for_cycle();

    zassert_equal(fake_notify_status_calls, 1, "notify should resume once the transfer ends");
}
```
